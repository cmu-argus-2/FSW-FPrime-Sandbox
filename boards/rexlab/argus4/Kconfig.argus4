## boards/rexlab/argus4/Kconfig.argus4
```kconfig
# SPDX-License-Identifier: Apache-2.0

config BOARD_ARGUS4
	select SOC_RP2350B_M33 if BOARD_ARGUS4_RP2350B_M33
```

## boards/rexlab/argus4/board.yml
```yaml
board:
  name: argus4
  full_name: Argus 4 CubeSat Mainboard
  vendor: rexlab
  socs:
  - name: rp2350b
```
